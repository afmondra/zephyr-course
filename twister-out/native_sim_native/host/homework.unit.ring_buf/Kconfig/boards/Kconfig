## twister-out/native_sim_native/host/homework.unit.ring_buf/Kconfig/boards/Kconfig
```kconfig
# Load Zephyr board Kconfig descriptions.
osource "/home/afmondra/deps/zephyr/boards/native/native_sim/Kconfig"
```

## twister-out/native_sim_native/host/homework.unit.ring_buf/Kconfig/boards/Kconfig.defconfig
```kconfig
# Load Zephyr board defconfig descriptions.
osource "/home/afmondra/deps/zephyr/boards/native/native_sim/Kconfig.defconfig"
```

## twister-out/native_sim_native/host/homework.unit.ring_buf/Kconfig/boards/Kconfig.native_sim
```kconfig
# Load board Kconfig descriptions.
osource "/home/afmondra/deps/zephyr/boards/native/native_sim/Kconfig.native_sim"
```

## twister-out/native_sim_native/host/homework.unit.ring_buf/Kconfig/boards/Kconfig.sysbuild
```kconfig
# Load Sysbuild board Kconfig descriptions.
osource "/home/afmondra/deps/zephyr/boards/native/native_sim/Kconfig.sysbuild"
```

## twister-out/nrf5340dk_nrf5340_cpuapp/zephyr_gnu/tests/calculator/example.unit.calculator.ordered/Kconfig/boards/Kconfig.nrf5340dk
```kconfig
# Load board Kconfig descriptions.
osource "/Users/bytelight/zephyr-course/zephyr/boards/nordic/nrf5340dk/Kconfig.nrf5340dk"
```
