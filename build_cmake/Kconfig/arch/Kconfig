## twister-out.4/qemu_rx_r5f562n8/zephyr_gnu/samples/kernel/msg_queue/sample.kernel.msgqueue/Kconfig/boards/Kconfig
```kconfig
# Load Zephyr board Kconfig descriptions.
osource "/Users/bytelight/zephyr-course/zephyr/boards/qemu/rx/Kconfig"
```

## twister-out.4/qemu_rx_r5f562n8/zephyr_gnu/samples/kernel/msg_queue/sample.kernel.msgqueue/Kconfig/boards/Kconfig.qemu_rx
```kconfig
# Load board Kconfig descriptions.
osource "/Users/bytelight/zephyr-course/zephyr/boards/qemu/rx/Kconfig.qemu_rx"
```

## twister-out.4/qemu_rx_r5f562n8/zephyr_gnu/samples/kernel/msg_queue/sample.kernel.msgqueue/Kconfig/boards/Kconfig.sysbuild
```kconfig
# Load Sysbuild board Kconfig descriptions.
osource "/Users/bytelight/zephyr-course/zephyr/boards/qemu/rx/Kconfig.sysbuild"
```

## twister-out/native_sim_native/host/homework.unit.ring_buf/Kconfig/arch/Kconfig
```kconfig
# Load Zephyr Arch Kconfig descriptions.
osource "/home/afmondra/deps/zephyr/arch/rx/Kconfig"
osource "/home/afmondra/deps/zephyr/arch/x86/Kconfig"
osource "/home/afmondra/deps/zephyr/arch/xtensa/Kconfig"
osource "/home/afmondra/deps/zephyr/arch/sparc/Kconfig"
osource "/home/afmondra/deps/zephyr/arch/riscv/Kconfig"
osource "/home/afmondra/deps/zephyr/arch/posix/Kconfig"
osource "/home/afmondra/deps/zephyr/arch/mips/Kconfig"
osource "/home/afmondra/deps/zephyr/arch/arm64/Kconfig"
osource "/home/afmondra/deps/zephyr/arch/arm/Kconfig"
osource "/home/afmondra/deps/zephyr/arch/arc/Kconfig"
```
