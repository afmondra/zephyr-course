## build_cmake/Kconfig/arch/Kconfig
```kconfig
# Load Zephyr Arch Kconfig descriptions.
osource "/home/afmondra/zephyrproject/zephyr/arch/rx/Kconfig"
osource "/home/afmondra/zephyrproject/zephyr/arch/x86/Kconfig"
osource "/home/afmondra/zephyrproject/zephyr/arch/xtensa/Kconfig"
osource "/home/afmondra/zephyrproject/zephyr/arch/sparc/Kconfig"
osource "/home/afmondra/zephyrproject/zephyr/arch/riscv/Kconfig"
osource "/home/afmondra/zephyrproject/zephyr/arch/posix/Kconfig"
osource "/home/afmondra/zephyrproject/zephyr/arch/mips/Kconfig"
osource "/home/afmondra/zephyrproject/zephyr/arch/arm64/Kconfig"
osource "/home/afmondra/zephyrproject/zephyr/arch/arm/Kconfig"
osource "/home/afmondra/zephyrproject/zephyr/arch/arc/Kconfig"
```

## build_cmake/Kconfig/boards/Kconfig
```kconfig
# Load Zephyr board Kconfig descriptions.
osource "/home/afmondra/zephyrproject/zephyr/boards/nordic/nrf5340dk/Kconfig"
```

## build_cmake/Kconfig/boards/Kconfig.defconfig
```kconfig
# Load Zephyr board defconfig descriptions.
osource "/home/afmondra/zephyrproject/zephyr/boards/nordic/nrf5340dk/Kconfig.defconfig"
```

## build_cmake/Kconfig/boards/Kconfig.nrf5340dk
```kconfig
# Load board Kconfig descriptions.
osource "/home/afmondra/zephyrproject/zephyr/boards/nordic/nrf5340dk/Kconfig.nrf5340dk"
```

## twister-out.11/nrf5340dk_nrf5340_cpuapp/zephyr_gnu/tests/calculator/example.unit.calculator/Kconfig/boards/Kconfig.defconfig
```kconfig
# Load Zephyr board defconfig descriptions.
osource "/Users/bytelight/zephyr-course/zephyr/boards/nordic/nrf5340dk/Kconfig.defconfig"
```

## twister-out.12/nrf5340dk_nrf5340_cpuapp/zephyr_gnu/tests/calculator/example.unit.calculator.ordered/Kconfig/boards/Kconfig
```kconfig
# Load Zephyr board Kconfig descriptions.
osource "/Users/bytelight/zephyr-course/zephyr/boards/nordic/nrf5340dk/Kconfig"
```

## twister-out.12/nrf5340dk_nrf5340_cpuapp/zephyr_gnu/tests/calculator/example.unit.calculator.ordered/Kconfig/soc/Kconfig
```kconfig
# Load Zephyr SoC Kconfig descriptions.
osource "/Users/bytelight/zephyr-course/zephyr/soc/xlnx/zynqmp/Kconfig"
osource "/Users/bytelight/zephyr-course/zephyr/soc/xlnx/zynq7000/Kconfig"
osource "/Users/bytelight/zephyr-course/zephyr/soc/xlnx/versalnet/Kconfig"
osource "/Users/bytelight/zephyr-course/zephyr/soc/xlnx/versal2/Kconfig"
osource "/Users/bytelight/zephyr-course/zephyr/soc/xlnx/versal/Kconfig"
osource "/Users/bytelight/zephyr-course/zephyr/soc/xen/Kconfig"
osource "/Users/bytelight/zephyr-course/zephyr/soc/wch/ch32v/Kconfig"
osource "/Users/bytelight/zephyr-course/zephyr/soc/ti/simplelink/Kconfig"
osource "/Users/bytelight/zephyr-course/zephyr/soc/ti/mspm0/Kconfig"
osource "/Users/bytelight/zephyr-course/zephyr/soc/ti/lm3s6965/Kconfig"
osource "/Users/bytelight/zephyr-course/zephyr/soc/ti/k3/Kconfig"
osource "/Users/bytelight/zephyr-course/zephyr/soc/telink/tlsr/Kconfig"
osource "/Users/bytelight/zephyr-course/zephyr/soc/syna/sr100/Kconfig"
osource "/Users/bytelight/zephyr-course/zephyr/soc/starfive/jh71xx/Kconfig"
osource "/Users/bytelight/zephyr-course/zephyr/soc/st/stm32/Kconfig"
osource "/Users/bytelight/zephyr-course/zephyr/soc/snps/qemu_arc/Kconfig"
osource "/Users/bytelight/zephyr-course/zephyr/soc/snps/nsim/arc_v/Kconfig"
osource "/Users/bytelight/zephyr-course/zephyr/soc/snps/nsim/arc_classic/Kconfig"
osource "/Users/bytelight/zephyr-course/zephyr/soc/snps/hsdk4xd/Kconfig"
osource "/Users/bytelight/zephyr-course/zephyr/soc/snps/hsdk/Kconfig"
osource "/Users/bytelight/zephyr-course/zephyr/soc/snps/emsk/Kconfig"
osource "/Users/bytelight/zephyr-course/zephyr/soc/snps/emsdp/Kconfig"
osource "/Users/bytelight/zephyr-course/zephyr/soc/snps/arc_iot/Kconfig"
osource "/Users/bytelight/zephyr-course/zephyr/soc/silabs/Kconfig"
osource "/Users/bytelight/zephyr-course/zephyr/soc/sifli/sf32/Kconfig"
osource "/Users/bytelight/zephyr-course/zephyr/soc/sifive/sifive_freedom/Kconfig"
osource "/Users/bytelight/zephyr-course/zephyr/soc/sensry/Kconfig"
osource "/Users/bytelight/zephyr-course/zephyr/soc/rockchip/Kconfig"
osource "/Users/bytelight/zephyr-course/zephyr/soc/renode/riscv_virtual/Kconfig"
osource "/Users/bytelight/zephyr-course/zephyr/soc/renode/cortex_r8_virtual/Kconfig"
osource "/Users/bytelight/zephyr-course/zephyr/soc/renesas/smartbond/Kconfig"
osource "/Users/bytelight/zephyr-course/zephyr/soc/renesas/rz/Kconfig"
osource "/Users/bytelight/zephyr-course/zephyr/soc/renesas/rx/Kconfig"
osource "/Users/bytelight/zephyr-course/zephyr/soc/renesas/rcar/Kconfig"
osource "/Users/bytelight/zephyr-course/zephyr/soc/renesas/ra/Kconfig"
osource "/Users/bytelight/zephyr-course/zephyr/soc/realtek/fingerprint/Kconfig"
osource "/Users/bytelight/zephyr-course/zephyr/soc/realtek/ec/Kconfig"
osource "/Users/bytelight/zephyr-course/zephyr/soc/realtek/bee/Kconfig"
osource "/Users/bytelight/zephyr-course/zephyr/soc/realtek/ameba/Kconfig"
osource "/Users/bytelight/zephyr-course/zephyr/soc/raspberrypi/rpi_pico/Kconfig"
osource "/Users/bytelight/zephyr-course/zephyr/soc/quicklogic/eos_s3/Kconfig"
osource "/Users/bytelight/zephyr-course/zephyr/soc/qemu/virt_riscv/Kconfig"
osource "/Users/bytelight/zephyr-course/zephyr/soc/qemu/or1k/Kconfig"
osource "/Users/bytelight/zephyr-course/zephyr/soc/qemu/malta/Kconfig"
osource "/Users/bytelight/zephyr-course/zephyr/soc/openisa/rv32m1/Kconfig"
osource "/Users/bytelight/zephyr-course/zephyr/soc/openhwgroup/cva6/Kconfig"
osource "/Users/bytelight/zephyr-course/zephyr/soc/oct/osd32mp15x/Kconfig"
osource "/Users/bytelight/zephyr-course/zephyr/soc/nxp/s32/Kconfig"
osource "/Users/bytelight/zephyr-course/zephyr/soc/nxp/rw/Kconfig"
osource "/Users/bytelight/zephyr-course/zephyr/soc/nxp/mcx/Kconfig"
osource "/Users/bytelight/zephyr-course/zephyr/soc/nxp/lpc/Kconfig"
osource "/Users/bytelight/zephyr-course/zephyr/soc/nxp/layerscape/Kconfig"
osource "/Users/bytelight/zephyr-course/zephyr/soc/nxp/kinetis/Kconfig"
osource "/Users/bytelight/zephyr-course/zephyr/soc/nxp/imxrt/Kconfig"
osource "/Users/bytelight/zephyr-course/zephyr/soc/nxp/imx/Kconfig"
osource "/Users/bytelight/zephyr-course/zephyr/soc/nuvoton/numicro/Kconfig"
osource "/Users/bytelight/zephyr-course/zephyr/soc/nuvoton/numaker/Kconfig"
osource "/Users/bytelight/zephyr-course/zephyr/soc/nuvoton/npcx/Kconfig"
osource "/Users/bytelight/zephyr-course/zephyr/soc/nuvoton/npcm/Kconfig"
osource "/Users/bytelight/zephyr-course/zephyr/soc/nordic/Kconfig"
osource "/Users/bytelight/zephyr-course/zephyr/soc/neorv32/Kconfig"
osource "/Users/bytelight/zephyr-course/zephyr/soc/native/inf_clock/Kconfig"
osource "/Users/bytelight/zephyr-course/zephyr/soc/microchip/sam/sama7/Kconfig"
osource "/Users/bytelight/zephyr-course/zephyr/soc/microchip/sam/sam_d5x_e5x/Kconfig"
osource "/Users/bytelight/zephyr-course/zephyr/soc/microchip/pic64/Kconfig"
osource "/Users/bytelight/zephyr-course/zephyr/soc/microchip/pic32c/pic32cz_ca/Kconfig"
osource "/Users/bytelight/zephyr-course/zephyr/soc/microchip/pic32c/pic32cx_sg/Kconfig"
osource "/Users/bytelight/zephyr-course/zephyr/soc/microchip/pic32c/pic32cm_sg_gc/Kconfig"
osource "/Users/bytelight/zephyr-course/zephyr/soc/microchip/pic32c/pic32cm_pl/Kconfig"
osource "/Users/bytelight/zephyr-course/zephyr/soc/microchip/pic32c/pic32cm_jh/Kconfig"
osource "/Users/bytelight/zephyr-course/zephyr/soc/microchip/pic32c/pic32ck_sg_gc/Kconfig"
osource "/Users/bytelight/zephyr-course/zephyr/soc/microchip/miv/Kconfig"
osource "/Users/bytelight/zephyr-course/zephyr/soc/microchip/mec/Kconfig"
osource "/Users/bytelight/zephyr-course/zephyr/soc/mediatek/mt8xxx/Kconfig"
osource "/Users/bytelight/zephyr-course/zephyr/soc/lowrisc/opentitan/Kconfig"
osource "/Users/bytelight/zephyr-course/zephyr/soc/litex/Kconfig"
osource "/Users/bytelight/zephyr-course/zephyr/soc/ite/ec/Kconfig"
osource "/Users/bytelight/zephyr-course/zephyr/soc/intel/wildcat_lake/Kconfig"
osource "/Users/bytelight/zephyr-course/zephyr/soc/intel/raptor_lake/Kconfig"
osource "/Users/bytelight/zephyr-course/zephyr/soc/intel/panther_lake/Kconfig"
osource "/Users/bytelight/zephyr-course/zephyr/soc/intel/lakemont/Kconfig"
osource "/Users/bytelight/zephyr-course/zephyr/soc/intel/intel_socfpga_std/Kconfig"
osource "/Users/bytelight/zephyr-course/zephyr/soc/intel/intel_socfpga/Kconfig"
osource "/Users/bytelight/zephyr-course/zephyr/soc/intel/intel_niosv/Kconfig"
osource "/Users/bytelight/zephyr-course/zephyr/soc/intel/intel_ish/Kconfig"
osource "/Users/bytelight/zephyr-course/zephyr/soc/intel/intel_adsp/Kconfig"
osource "/Users/bytelight/zephyr-course/zephyr/soc/intel/elkhart_lake/Kconfig"
osource "/Users/bytelight/zephyr-course/zephyr/soc/intel/atom/Kconfig"
osource "/Users/bytelight/zephyr-course/zephyr/soc/intel/apollo_lake/Kconfig"
osource "/Users/bytelight/zephyr-course/zephyr/soc/intel/alder_lake/Kconfig"
osource "/Users/bytelight/zephyr-course/zephyr/soc/infineon/psoc4/Kconfig"
osource "/Users/bytelight/zephyr-course/zephyr/soc/infineon/edge/Kconfig"
osource "/Users/bytelight/zephyr-course/zephyr/soc/infineon/cat3/Kconfig"
osource "/Users/bytelight/zephyr-course/zephyr/soc/infineon/cat1c/Kconfig"
osource "/Users/bytelight/zephyr-course/zephyr/soc/infineon/cat1b/Kconfig"
osource "/Users/bytelight/zephyr-course/zephyr/soc/infineon/cat1a/Kconfig"
osource "/Users/bytelight/zephyr-course/zephyr/soc/gd/gd32/Kconfig"
osource "/Users/bytelight/zephyr-course/zephyr/soc/gaisler/leon3/Kconfig"
osource "/Users/bytelight/zephyr-course/zephyr/soc/gaisler/gr716a/Kconfig"
osource "/Users/bytelight/zephyr-course/zephyr/soc/focaltech/Kconfig"
osource "/Users/bytelight/zephyr-course/zephyr/soc/espressif/Kconfig"
osource "/Users/bytelight/zephyr-course/zephyr/soc/ene/kb1200/Kconfig"
osource "/Users/bytelight/zephyr-course/zephyr/soc/ene/kb106x/Kconfig"
osource "/Users/bytelight/zephyr-course/zephyr/soc/elan/em32f967/Kconfig"
osource "/Users/bytelight/zephyr-course/zephyr/soc/egis/Kconfig"
osource "/Users/bytelight/zephyr-course/zephyr/soc/efinix/sapphire/Kconfig"
osource "/Users/bytelight/zephyr-course/zephyr/soc/cdns/xtensa_sample_controller/Kconfig"
osource "/Users/bytelight/zephyr-course/zephyr/soc/cdns/swerv/Kconfig"
osource "/Users/bytelight/zephyr-course/zephyr/soc/cdns/sample_controller32/Kconfig"
osource "/Users/bytelight/zephyr-course/zephyr/soc/cdns/dc233c/Kconfig"
osource "/Users/bytelight/zephyr-course/zephyr/soc/brcm/bcmvk/Kconfig"
osource "/Users/bytelight/zephyr-course/zephyr/soc/brcm/bcm2712/Kconfig"
osource "/Users/bytelight/zephyr-course/zephyr/soc/brcm/bcm2711/Kconfig"
osource "/Users/bytelight/zephyr-course/zephyr/soc/blackberry/qnxhv_vm/Kconfig"
osource "/Users/bytelight/zephyr-course/zephyr/soc/bflb/Kconfig"
osource "/Users/bytelight/zephyr-course/zephyr/soc/atmel/sam0/Kconfig"
osource "/Users/bytelight/zephyr-course/zephyr/soc/atmel/sam/Kconfig"
osource "/Users/bytelight/zephyr-course/zephyr/soc/aspeed/Kconfig"
osource "/Users/bytelight/zephyr-course/zephyr/soc/arm/Kconfig"
osource "/Users/bytelight/zephyr-course/zephyr/soc/arm/beetle/Kconfig"
osource "/Users/bytelight/zephyr-course/zephyr/soc/antmicro/myra/Kconfig"
osource "/Users/bytelight/zephyr-course/zephyr/soc/andestech/Kconfig"
osource "/Users/bytelight/zephyr-course/zephyr/soc/amd/acp_7_0/Kconfig"
osource "/Users/bytelight/zephyr-course/zephyr/soc/amd/acp_6_0/Kconfig"
osource "/Users/bytelight/zephyr-course/zephyr/soc/ambiq/Kconfig"
osource "/Users/bytelight/zephyr-course/zephyr/soc/allwinner/sun8i_h3/Kconfig"
osource "/Users/bytelight/zephyr-course/zephyr/soc/alif/ensemble/Kconfig"
osource "/Users/bytelight/zephyr-course/zephyr/soc/alif/balletto/Kconfig"
osource "/Users/bytelight/zephyr-course/zephyr/soc/aesc/Kconfig"
osource "/Users/bytelight/zephyr-course/zephyr/soc/adi/max32/Kconfig"
```

## twister-out.4/qemu_arc_qemu_arc_em/zephyr_gnu/samples/kernel/msg_queue/sample.kernel.msgqueue/Kconfig/boards/Kconfig.defconfig
```kconfig
# Load Zephyr board defconfig descriptions.
osource "/Users/bytelight/zephyr-course/zephyr/boards/qemu/arc/Kconfig.defconfig"
```

## twister-out.4/qemu_arc_qemu_arc_hs/zephyr_gnu/samples/kernel/msg_queue/sample.kernel.msgqueue/Kconfig/boards/Kconfig.sysbuild
```kconfig
# Load Sysbuild board Kconfig descriptions.
osource "/Users/bytelight/zephyr-course/zephyr/boards/qemu/arc/Kconfig.sysbuild"
```

## twister-out.4/qemu_arc_qemu_arc_hs6x/zephyr_gnu/samples/kernel/msg_queue/sample.kernel.msgqueue/Kconfig/boards/Kconfig
```kconfig
# Load Zephyr board Kconfig descriptions.
osource "/Users/bytelight/zephyr-course/zephyr/boards/qemu/arc/Kconfig"
```

## twister-out.4/qemu_arc_qemu_arc_hs6x/zephyr_gnu/samples/kernel/msg_queue/sample.kernel.msgqueue/Kconfig/boards/Kconfig.qemu_arc
```kconfig
# Load board Kconfig descriptions.
osource "/Users/bytelight/zephyr-course/zephyr/boards/qemu/arc/Kconfig.qemu_arc"
```

## twister-out.4/qemu_cortex_m0_nrf51822/zephyr_gnu/samples/kernel/msg_queue/sample.kernel.msgqueue/Kconfig/arch/Kconfig
```kconfig
# Load Zephyr Arch Kconfig descriptions.
osource "/Users/bytelight/zephyr-course/zephyr/arch/rx/Kconfig"
osource "/Users/bytelight/zephyr-course/zephyr/arch/x86/Kconfig"
osource "/Users/bytelight/zephyr-course/zephyr/arch/xtensa/Kconfig"
osource "/Users/bytelight/zephyr-course/zephyr/arch/sparc/Kconfig"
osource "/Users/bytelight/zephyr-course/zephyr/arch/riscv/Kconfig"
osource "/Users/bytelight/zephyr-course/zephyr/arch/posix/Kconfig"
osource "/Users/bytelight/zephyr-course/zephyr/arch/openrisc/Kconfig"
osource "/Users/bytelight/zephyr-course/zephyr/arch/mips/Kconfig"
osource "/Users/bytelight/zephyr-course/zephyr/arch/arm64/Kconfig"
osource "/Users/bytelight/zephyr-course/zephyr/arch/arm/Kconfig"
osource "/Users/bytelight/zephyr-course/zephyr/arch/arc/Kconfig"
```

## twister-out.4/qemu_cortex_m0_nrf51822/zephyr_gnu/samples/kernel/msg_queue/sample.kernel.msgqueue/Kconfig/boards/Kconfig.defconfig
```kconfig
# Load Zephyr board defconfig descriptions.
osource "/Users/bytelight/zephyr-course/zephyr/boards/qemu/cortex_m0/Kconfig.defconfig"
```

## twister-out.4/qemu_cortex_m0_nrf51822/zephyr_gnu/samples/kernel/msg_queue/sample.kernel.msgqueue/Kconfig/boards/Kconfig.qemu_cortex_m0
```kconfig
# Load board Kconfig descriptions.
osource "/Users/bytelight/zephyr-course/zephyr/boards/qemu/cortex_m0/Kconfig.qemu_cortex_m0"
```

## twister-out.4/qemu_cortex_m0_nrf51822/zephyr_gnu/samples/kernel/msg_queue/sample.kernel.msgqueue/Kconfig/boards/Kconfig.sysbuild
```kconfig
# Load Sysbuild board Kconfig descriptions.
osource "/Users/bytelight/zephyr-course/zephyr/boards/qemu/cortex_m0/Kconfig.sysbuild"
```

## twister-out.4/qemu_leon3_leon3/zephyr_gnu/samples/kernel/msg_queue/sample.kernel.msgqueue/Kconfig/boards/Kconfig
```kconfig
# Load Zephyr board Kconfig descriptions.
osource "/Users/bytelight/zephyr-course/zephyr/boards/qemu/leon3/Kconfig"
```

## twister-out.4/qemu_leon3_leon3/zephyr_gnu/samples/kernel/msg_queue/sample.kernel.msgqueue/Kconfig/boards/Kconfig.defconfig
```kconfig
# Load Zephyr board defconfig descriptions.
osource "/Users/bytelight/zephyr-course/zephyr/boards/qemu/leon3/Kconfig.defconfig"
```

## twister-out.4/qemu_leon3_leon3/zephyr_gnu/samples/kernel/msg_queue/sample.kernel.msgqueue/Kconfig/boards/Kconfig.qemu_leon3
```kconfig
# Load board Kconfig descriptions.
osource "/Users/bytelight/zephyr-course/zephyr/boards/qemu/leon3/Kconfig.qemu_leon3"
```

## twister-out.4/qemu_malta_qemu_malta/zephyr_gnu/samples/kernel/msg_queue/sample.kernel.msgqueue/Kconfig/boards/Kconfig
```kconfig
# Load Zephyr board Kconfig descriptions.
osource "/Users/bytelight/zephyr-course/zephyr/boards/qemu/malta/Kconfig"
```

## twister-out.4/qemu_malta_qemu_malta/zephyr_gnu/samples/kernel/msg_queue/sample.kernel.msgqueue/Kconfig/boards/Kconfig.sysbuild
```kconfig
# Load Sysbuild board Kconfig descriptions.
osource "/Users/bytelight/zephyr-course/zephyr/boards/qemu/malta/Kconfig.sysbuild"
```

## twister-out.4/qemu_malta_qemu_malta_be/zephyr_gnu/samples/kernel/msg_queue/sample.kernel.msgqueue/Kconfig/boards/Kconfig.defconfig
```kconfig
# Load Zephyr board defconfig descriptions.
osource "/Users/bytelight/zephyr-course/zephyr/boards/qemu/malta/Kconfig.defconfig"
```
