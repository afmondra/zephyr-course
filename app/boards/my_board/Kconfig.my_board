## app/boards/my_board/Kconfig.my_board
```kconfig
 config BOARD_MY_BOARD_NRF5340_CPUAPP
	select SOC_NRF5340_CPUAPP_QKAA if BOARD_MY_BOARD_NRF5340_CPUAPP
```

## app/boards/my_board/board.yml
```yaml
board:
  name: my_board
  full_name: My Board from scratch
  vendor: nordic
  socs:
  - name: 'nrf5340'
```

## app/boards/our_board/board.yml
```yaml
board:
  name: our_board
  full_name: Our Board
  vendor: nordic
  socs:
  - name: 'nrf5340'
```

## app/drivers/our_driver/Kconfig
```kconfig
# SPDX-License-Identifier: Apache-2.0

config OUR_DRIVER
    bool "Our Driver"
    default y
    select GPIO
```
